## firmware/components/device_link/Kconfig.projbuild
```kconfig
menu "Feldspar structured observation link"
config FELDSPAR_FEATURE_LINK
    bool "Enable feature uplink and bounded command receiver"
    default n
    help
        Requires a device-specific device_link NVS profile: device_id,
        device_key and mqtts broker_uri. Never falls back to the legacy
        service account. Sends structured DSP features, not raw recordings.
        Automatic actuation remains disabled pending physical validation.
endmenu
```

## firmware/main/Kconfig.projbuild
```kconfig
menu "Feldspar hardware"

config FELDSPAR_BUTTON_ACTIVE_HIGH
    bool "Use an active-high GPIO7 button module"
    default n
    help
        Enable only for a board whose button drives GPIO7 high when pressed.
        The default uses an active-low button with an internal pull-up.

config FELDSPAR_PRESERVE_EXISTING_STORAGE
    bool "Preserve provisioned storage at startup"
    default n
    help
        For upgrades on an existing sample. Avoid erasing NVS, formatting
        external storage on a mount error, or writing the flash test sector.

endmenu
```
